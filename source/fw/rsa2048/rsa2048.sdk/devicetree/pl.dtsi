/*
 * CAUTION: This file is automatically generated by Xilinx.
 * Version:  
 * Today is: Fri Jan 20 14:32:58 2017
*/


/ {
	amba_pl: amba_pl {
		#address-cells = <1>;
		#size-cells = <1>;
		compatible = "simple-bus";
		ranges ;
		encrypt_0: encrypt@43c00000 {
			compatible = "xlnx,encrypt-1.0";
			interrupt-parent = <&intc>;
			interrupts = <0 29 4>;
			reg = <0x43c00000 0x10000>;
			xlnx,s-axi-periph-bus-addr-width = <0x8>;
			xlnx,s-axi-periph-bus-data-width = <0x20>;
		};
	};
};
