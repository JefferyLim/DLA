/*
 * CAUTION: This file is automatically generated by Xilinx.
 * Version:  
 * Today is: Wed Feb  1 15:38:10 2017
*/


/ {
	amba_pl: amba_pl {
		#address-cells = <1>;
		#size-cells = <1>;
		compatible = "simple-bus";
		ranges ;
		bigint_math_0: bigint_math@43c00000 {
			compatible = "xlnx,bigint-math-1.0";
			reg = <0x43c00000 0x10000>;
			xlnx,s-axi-periph-bus-addr-width = <0xa>;
			xlnx,s-axi-periph-bus-data-width = <0x20>;
		};
	};
};
